/dts-v1/;
/plugin/;

/ {
    compatible = "brcm,bcm2835";

    fragment@0 {
        target = <&spi0>;
        __overlay__ {
            status = "okay";

            ili9341@0 {
                compatible = "adafruit,yx240qv29", "ilitek,ili9341";

                reg = <0>;

                spi-max-frequency = <32000000>;

                dc-gpios = <&gpio 6 0>;
                reset-gpios = <&gpio 5 0>;

                rotation = <270>;

                status = "okay";
            };
        };
    };
};
